## oe/conf/distro/include/glibc.inc
```bitbake
# Add glibc to the overrides.
OVERRIDES .= ":libc-glibc"

PREFERRED_PROVIDER_virtual/${TARGET_PREFIX}binutils = "binutils-cross"
PREFERRED_PROVIDER_virtual/${TARGET_PREFIX}libc-for-gcc = "glibc"
PREFERRED_PROVIDER_virtual/${TARGET_PREFIX}libc-initial = "glibc-initial"
PREFERRED_PROVIDER_virtual/${TARGET_PREFIX}gcc-initial = "gcc-cross-initial"
PREFERRED_PROVIDER_virtual/${TARGET_PREFIX}gcc-intermediate = "gcc-cross-intermediate"
PREFERRED_PROVIDER_virtual/libc     = "glibc"
PREFERRED_PROVIDER_virtual/libiconv = "glibc"
PREFERRED_PROVIDER_virtual/libintl  = "glibc"
PREFERRED_PROVIDER_linux-libc-headers = "linux-libc-headers"
```

## oe/conf/distro/include/toolchain-samsung.inc
```bitbake
OVERRIDES .= ":${FEED_ARCH}"

ARM_KEEP_OABI = "0"
LOCALE_UTF8_ONLY = "1"

PREFERRED_VERSION_gcc-cross = "4.2.0-4.0.9"
PREFERRED_VERSION_gcc-cross-initial = "4.2.0-4.0.9"
PREFERRED_VERSION_gcc-cross-intermediate = "4.2.0-4.0.9"
PREFERRED_VERSION_binutils = "2.17.50"
PREFERRED_VERSION_binutils-cross = "2.17.50"
PREFERRED_VERSION_linux-libc-headers = "2.6.18"
PREFERRED_VERSION_glibc = "2.5.90-9.0.9"
PREFERRED_VERSION_glibc-initial = "2.5.90-9.0.9"

require conf/distro/include/sane-toolchain-glibc.inc
```

## oe/conf/distro/samygo-cl.conf
```bitbake
#@TYPE: Distribution
#@NAME: samygo-cl
#@DESCRIPTION: Distribution configuration for SamyGO Content Library Games
MAINTAINER = "SamyGO Team"

require conf/distro/samygo.conf

PREFERRED_VERSION_scummvm-cl = "1.7.0"
```

## oe/conf/distro/samygo.conf
```bitbake
#@TYPE: Distribution
#@NAME: samygo
#@DESCRIPTION: Distribution configuration for SamyGO
MAINTAINER = "SamyGO Team"

DISTRO_FEATURES = "kernel26 ipv4 largefile"

INHERIT += "insane recipe_sanity sanity debian devshell package_ipk packaged-staging"

PREFERRED_PROVIDERS += "virtual/${TARGET_PREFIX}gcc-initial:gcc-cross-initial"
PREFERRED_PROVIDERS += " virtual/${TARGET_PREFIX}gcc-intermediate:gcc-cross-intermediate"
PREFERRED_PROVIDERS += " virtual/${TARGET_PREFIX}gcc:gcc-cross"
PREFERRED_PROVIDERS += " virtual/${TARGET_PREFIX}g++:gcc-cross"

PREFERRED_PROVIDER_opkg = "opkg"
PREFERRED_PROVIDER_hotplug = "busybox-mdev"

PREFERRED_PROVIDER_virtual/update-alternatives = "opkg"
PREFERRED_PROVIDER_virtual/update-alternatives-native = "opkg-native"

IPKG_VARIANT = "opkg"

IMAGE_DEV_MANAGER = "busybox-mdev"

require conf/distro/include/glibc.inc
require conf/distro/include/arm-thumb.inc

LIMIT_BUILT_LOCALES ?= "en_GB"

USE_NLS = "no"

USE_VT = "0"
SYSVINIT_ENABLED_GETTYS = "1"

SERIAL_CONSOLE = "115200 ttyS1"

USE_NLS = "no"
USE_NLS_glib-2.0 = "yes"
USE_NLS_glib-2.0-native = "yes"
USE_NLS_gcc-cross = "no"
```

## oe/conf/machine/include/common.inc
```bitbake
#
# Hardware-based properties
#
TARGET_ARCH = "arm"
TARGET_FPU = "soft"

MACHINE_FEATURES = "kernel26"
MACHINE_KERNEL_VERSION = "2.6"

SERIAL_CONSOLE = "115200 ttyS0 vt100"
```

## oe/conf/machine/ssdtv.conf
```bitbake
#@TYPE: Machine
#@NAME: Samsung DTV with Chelsea chip revision 2
#@DESCRIPTION: Machine Configuration for a lot of Samsung TV's (LCD, LED & Plasma)
#
# no PCI(ethernet), 128MB flash, 256MB RAM:
#	LAxxB550, PSxxB550, UAxxB6000
#	LExxB55x, LExxB620, LExxB625, PSxxB55x, PSxxB560, PSxxB610, UExxB6000
# CI+ : LExxB579, LExxB550A5P
#
# 128MB flash, 256MB RAM:
# 	LNxxB610, LNxxB630, UNxxB6000
#
# 1GB flash, 512MB RAM:
# 	LNxxB650, LNxxB750, PNxxB650, PNxxB850, PNxxB860
#	LAxxB650, LAxxB750, PSxxB650
#	LExxB65x, LExxB750, PSxxB650, PSxxB655
# CI+ : LExxB679, LExxB651T3P
#
# 2GB flash, 512MB RAM:
#	UNxxB7000, UNxxB7100, UNxxB8000, UNxxB8500
#	UAxxB7100, UAxxB8000, PSxxB850
#	UExxB7000, UExxB7020, UExxB7050, UExxB7070, UExxB8000
# CI+ : UExxB7090

TARGET_ARCH = "arm"
TARGET_FPU = "hard"

require conf/machine/include/common.inc
require conf/machine/include/tune-arm1136jf-s.inc

require conf/distro/include/toolchain-samsung.inc

MACHINE_KERNEL_VERSION = "2.6"
MACHINE_FEATURES = "kernel26"
```
